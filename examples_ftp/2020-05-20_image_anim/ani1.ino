/*
	animation bar+image
*/

#include <TFT.h>  // Arduino LCD library
#include <SPI.h>

#include <pgmspace.h>

// pin definition for the Uno
#define cs   10
#define dc   9
#define rst  8

// pin definition for the Leonardo
// #define cs   7
// #define dc   0
// #define rst  1

TFT TFTscreen = TFT(cs, dc, rst);

// Some ready-made 16-bit ('565') color settings:
#define COLOR_BLACK 0x0000
#define COLOR_WHITE 0xFFFF
#define COLOR_RED 0xF800
#define COLOR_GREEN 0x07E0
#define COLOR_BLUE 0x001F
#define COLOR_CYAN 0x07FF
#define COLOR_MAGENTA 0xF81F
#define COLOR_YELLOW 0xFFE0
#define COLOR_ORANGE 0xFC00

const PROGMEM word  myImage[0x30C] ={
0x0000, 0x0000, 0x0000, 0x0000, 0x0000, 0x0000, 0x0000, 0x0000, 0x0000, 0x0000, 0x0000, 0x0000, 0x0000, 0x0000, 0x0000, 0x0000,   // 0x0010 (16)
0x0000, 0x0000, 0x0000, 0x0000, 0x0000, 0x0000, 0x0000, 0x0000, 0x0000, 0x0000, 0x0000, 0x0000, 0x0000, 0x0000, 0x0000, 0x0000,   // 0x0020 (32)
0x0000, 0x0000, 0x0000, 0x0000, 0x0000, 0x0000, 0x0000, 0x0000, 0x0000, 0x0000, 0x0000, 0x0000, 0x0022, 0x0022, 0x0022, 0x0021,   // 0x0030 (48)
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0x1060, 0x20C1, 0x20A1, 0x1060, 0x0840, 0x0000, 0x0000, 0x0000, 0x0000, 0x0000, 0x0000, 0x0000, };

// court parameters
int courtX=5,courtY=10,courtW=150,courtH=108;
int courtTopLine=0,courtBottomLine=0,courtLeftLine=0,courtRightLine=0;

// bar move state
enum barstate_t {	bar0,bar1};
barstate_t barstate=bar0;

int incWbar=5,wbar=30;

unsigned long previousMillisBar=0,currentMillis=0;

void setup() {
	// initialize the display
	TFTscreen.begin();
	// black background
	TFTscreen.background(0, 0, 0);	
	// draw court
	TFTscreen.drawRect(courtX, courtY, courtW,courtH,0xF800);
}

void loop() {
	TFTscreen.drawFastVLine(20, 12, 104,COLOR_GREEN);
	TFTscreen.drawFastVLine(140, 12, 104,COLOR_GREEN);	
	bar();
}


void bar(){
	static int imagePosX=20,imagePosY=33,imageOldPosX=20;
	const int imageWidth=30,imageHeight=26;
	currentMillis=millis();	
	if(currentMillis-previousMillisBar>500){
		previousMillisBar=currentMillis;
		switch(barstate){
			case bar0:
				//image reading:
				int w = imageWidth, h = imageHeight, row, col, buffidx=0;  //w:width , h:height
				for (row=0; row<h; row++) {
					for (col=0; col<w; col++) {
						word p=pgm_read_word(myImage + buffidx);
						TFTscreen.drawPixel(col+imagePosX,row+imagePosY,p);
						buffidx++;
					}
				}			
				if(imagePosX != imageOldPosX){	//erase left part of the image
					TFTscreen.fillRect(imageOldPosX, imagePosY, incWbar, 26, COLOR_BLACK);
				}
				imageOldPosX=imagePosX;	
				TFTscreen.fillRect(20, 59, wbar, 10, COLOR_GREEN);
				if(wbar<=115){
					wbar+=incWbar;	
					imagePosX+=incWbar;
				}else{
					
				}
				break;				
			case bar1:
				
				break;	
		}										
	}
}

